## br2-external/Config.in
```kconfig
# Packages are provided by the hash-pinned Buildroot release.

config BR2_PACKAGE_EMBEDDED_OPENSSL_O2
    bool "Compile OpenSSL with O2 while other userland remains size optimized"
    depends on BR2_PACKAGE_LIBOPENSSL
    help
      Measure selective optimization of the upstream cryptographic/TLS package.
      Preserve the existing library source, algorithms, ABI and hardening.

config BR2_PACKAGE_TOR_CLIENT_ONLY
    bool "Tor client and onion service only"
    depends on BR2_PACKAGE_TOR
    help
      Use upstream's supported client build without relay, bridge-operator,
      directory-cache-server or directory-authority modules. Onion-service
      client/server functionality and cryptographic implementations remain.

config BR2_PACKAGE_TOR_OPTIMIZE_O2
    bool "Compile only Tor with -O2 for measured CPU ablation"
    depends on BR2_PACKAGE_TOR
    help
      Keep the small kernel and size-optimized libraries unchanged while
      measuring the performance/size effect of Tor's compiler optimization.
      Global Buildroot/toolchain hardening remains enabled.

config BR2_PACKAGE_TOR_GC_SECTIONS
    bool "Discard unreachable code and diagnostic executable symbol exports"
    depends on BR2_PACKAGE_TOR
    depends on BR2_TOOLCHAIN_USES_MUSL
    help
      Dedicated executable with network/control interfaces, not a shared
      library or plugin API. Remove -rdynamic, which upstream adds for
      diagnostic backtrace symbolization unavailable in this musl build,
      and garbage-collect unreachable function/data sections. Preserve
      unwind tables, CET, stack protection, PIE and full RELRO.
```

## br2-external/configs/tor_qemu_arm_capacity32_defconfig
```kconfig
BR2_arm=y
BR2_cortex_a7=y
BR2_TOOLCHAIN_BUILDROOT_MUSL=y
BR2_GCC_VERSION_15_X=y
BR2_BINUTILS_VERSION_2_45_X=y
BR2_KERNEL_HEADERS_AS_KERNEL=y
BR2_PACKAGE_HOST_LINUX_HEADERS_CUSTOM_6_18=y
BR2_REPRODUCIBLE=y
BR2_DOWNLOAD_FORCE_CHECK_HASHES=y
BR2_GLOBAL_PATCH_DIR="$(BR2_EXTERNAL_EMBEDDED_TOR_PATH)/patches"
BR2_OPTIMIZE_2=y
BR2_SSP_STRONG=y
BR2_PIC_PIE=y
BR2_RELRO_FULL=y
BR2_TARGET_GENERIC_HOSTNAME="embedded-tor-lab"
BR2_TARGET_GENERIC_ISSUE="Tor validation laboratory; no hardware verification"
# BR2_TARGET_ENABLE_ROOT_LOGIN is not set
# BR2_TARGET_GENERIC_GETTY is not set
BR2_SYSTEM_DHCP="eth0"
BR2_ROOTFS_OVERLAY="$(BR2_EXTERNAL_EMBEDDED_TOR_PATH)/board/qemu-production/overlay $(BR2_EXTERNAL_EMBEDDED_TOR_PATH)/board/qemu-compressed/overlay $(BR2_EXTERNAL_EMBEDDED_TOR_PATH)/board/qemu-capacity32/overlay"
BR2_ROOTFS_POST_BUILD_SCRIPT="$(BR2_EXTERNAL_EMBEDDED_TOR_PATH)/board/qemu-compressed/post-build.sh"
BR2_PACKAGE_BUSYBOX_CONFIG="$(BR2_EXTERNAL_EMBEDDED_TOR_PATH)/board/qemu-ram/busybox.config"
BR2_LINUX_KERNEL=y
BR2_LINUX_KERNEL_CUSTOM_VERSION=y
BR2_LINUX_KERNEL_CUSTOM_VERSION_VALUE="6.18.7"
BR2_LINUX_KERNEL_USE_CUSTOM_CONFIG=y
BR2_LINUX_KERNEL_CUSTOM_CONFIG_FILE="$(BR2_EXTERNAL_EMBEDDED_TOR_PATH)/board/qemu-arm-capacity32/linux.config"
BR2_LINUX_KERNEL_ZIMAGE=y
BR2_PACKAGE_TOR=y
BR2_PACKAGE_LIBSECCOMP=y
# BR2_TARGET_ROOTFS_EXT2 is not set
BR2_TARGET_ROOTFS_SQUASHFS=y
BR2_TARGET_ROOTFS_SQUASHFS4_XZ=y
BR2_TARGET_ROOTFS_SQUASHFS_EXTREME_COMP=y
# BR2_TARGET_ROOTFS_TAR is not set
BR2_PACKAGE_TOR_CLIENT_ONLY=y
BR2_ROOTFS_USERS_TABLES="$(BR2_EXTERNAL_EMBEDDED_TOR_PATH)/board/qemu-production/users.txt"
BR2_PACKAGE_HOST_GENIMAGE=y
BR2_PACKAGE_HOST_E2FSPROGS=y
BR2_ROOTFS_POST_IMAGE_SCRIPT="$(BR2_EXTERNAL_EMBEDDED_TOR_PATH)/board/qemu-capacity32/post-image.sh"
BR2_PACKAGE_TOR_OPTIMIZE_O2=y
BR2_PACKAGE_TOR_GC_SECTIONS=y
BR2_LINUX_KERNEL_XZ=y
```

## br2-external/configs/tor_qemu_arm_validation_fixture_defconfig
```kconfig
BR2_arm=y
BR2_cortex_a7=y
BR2_TOOLCHAIN_EXTERNAL=y
BR2_TOOLCHAIN_EXTERNAL_CUSTOM=y
BR2_TOOLCHAIN_EXTERNAL_PREINSTALLED=y
BR2_TOOLCHAIN_EXTERNAL_PATH="$(TOR_ARM_SDK)"
BR2_TOOLCHAIN_EXTERNAL_CUSTOM_PREFIX="arm-buildroot-linux-musleabihf"
BR2_TOOLCHAIN_EXTERNAL_GCC_15=y
BR2_TOOLCHAIN_EXTERNAL_HEADERS_6_18=y
BR2_TOOLCHAIN_EXTERNAL_CUSTOM_MUSL=y
BR2_TOOLCHAIN_EXTERNAL_HAS_SSP=y
BR2_TOOLCHAIN_EXTERNAL_HAS_SSP_STRONG=y
BR2_REPRODUCIBLE=y
BR2_DOWNLOAD_FORCE_CHECK_HASHES=y
BR2_GLOBAL_PATCH_DIR="$(BR2_EXTERNAL_EMBEDDED_TOR_PATH)/patches"
BR2_SSP_STRONG=y
BR2_PIC_PIE=y
BR2_RELRO_FULL=y
BR2_ROOTFS_OVERLAY="$(BR2_EXTERNAL_EMBEDDED_TOR_PATH)/board/qemu/overlay"
BR2_ROOTFS_POST_BUILD_SCRIPT="$(BR2_EXTERNAL_EMBEDDED_TOR_PATH)/board/qemu/post-build.sh"
BR2_PACKAGE_PYTHON3=y
BR2_PACKAGE_PYTHON3_SSL=y
BR2_TARGET_ROOTFS_EXT2=y
BR2_TARGET_ROOTFS_EXT2_4=y
BR2_TARGET_ROOTFS_EXT2_SIZE="64M"
# BR2_TARGET_ROOTFS_TAR is not set
```

## br2-external/configs/tor_qemu_x86_64_capacity32_defconfig
```kconfig
BR2_x86_64=y
BR2_TOOLCHAIN_EXTERNAL=y
BR2_TOOLCHAIN_EXTERNAL_CUSTOM=y
BR2_TOOLCHAIN_EXTERNAL_PREINSTALLED=y
BR2_TOOLCHAIN_EXTERNAL_PATH="$(BR2_EXTERNAL_EMBEDDED_TOR_PATH)/../build/toolchains/baseline-sdk"
BR2_TOOLCHAIN_EXTERNAL_CUSTOM_PREFIX="x86_64-buildroot-linux-musl"
BR2_TOOLCHAIN_EXTERNAL_GCC_15=y
BR2_TOOLCHAIN_EXTERNAL_HEADERS_6_18=y
BR2_TOOLCHAIN_EXTERNAL_CUSTOM_MUSL=y
BR2_TOOLCHAIN_EXTERNAL_HAS_SSP=y
BR2_TOOLCHAIN_EXTERNAL_HAS_SSP_STRONG=y
BR2_REPRODUCIBLE=y
BR2_DOWNLOAD_FORCE_CHECK_HASHES=y
BR2_GLOBAL_PATCH_DIR="$(BR2_EXTERNAL_EMBEDDED_TOR_PATH)/patches"
BR2_OPTIMIZE_S=y
BR2_SSP_STRONG=y
BR2_PIC_PIE=y
BR2_RELRO_FULL=y
BR2_TARGET_GENERIC_HOSTNAME="embedded-tor-lab"
BR2_TARGET_GENERIC_ISSUE="Tor validation laboratory; no hardware verification"
# BR2_TARGET_ENABLE_ROOT_LOGIN is not set
# BR2_TARGET_GENERIC_GETTY is not set
BR2_SYSTEM_DHCP="eth0"
BR2_ROOTFS_OVERLAY="$(BR2_EXTERNAL_EMBEDDED_TOR_PATH)/board/qemu-production/overlay $(BR2_EXTERNAL_EMBEDDED_TOR_PATH)/board/qemu-compressed/overlay"
BR2_ROOTFS_POST_BUILD_SCRIPT="$(BR2_EXTERNAL_EMBEDDED_TOR_PATH)/board/qemu-compressed/post-build.sh"
BR2_PACKAGE_BUSYBOX_CONFIG="$(BR2_EXTERNAL_EMBEDDED_TOR_PATH)/board/qemu-ram/busybox.config"
BR2_LINUX_KERNEL=y
BR2_LINUX_KERNEL_CUSTOM_VERSION=y
BR2_LINUX_KERNEL_CUSTOM_VERSION_VALUE="6.18.7"
BR2_LINUX_KERNEL_USE_CUSTOM_CONFIG=y
BR2_LINUX_KERNEL_CUSTOM_CONFIG_FILE="$(BR2_EXTERNAL_EMBEDDED_TOR_PATH)/board/qemu-selective/linux.config"
BR2_LINUX_KERNEL_NEEDS_HOST_LIBELF=y
BR2_PACKAGE_TOR=y
BR2_PACKAGE_LIBSECCOMP=y
# BR2_TARGET_ROOTFS_EXT2 is not set
BR2_TARGET_ROOTFS_SQUASHFS=y
BR2_TARGET_ROOTFS_SQUASHFS4_XZ=y
BR2_TARGET_ROOTFS_SQUASHFS_EXTREME_COMP=y
# BR2_TARGET_ROOTFS_TAR is not set
BR2_PACKAGE_TOR_CLIENT_ONLY=y
BR2_ROOTFS_USERS_TABLES="$(BR2_EXTERNAL_EMBEDDED_TOR_PATH)/board/qemu-production/users.txt"
BR2_PACKAGE_HOST_GENIMAGE=y
BR2_PACKAGE_HOST_E2FSPROGS=y
BR2_ROOTFS_POST_IMAGE_SCRIPT="$(BR2_EXTERNAL_EMBEDDED_TOR_PATH)/board/qemu-capacity32/post-image.sh"
BR2_PACKAGE_TOR_OPTIMIZE_O2=y
BR2_PACKAGE_TOR_GC_SECTIONS=y
BR2_LINUX_KERNEL_XZ=y
BR2_PACKAGE_EMBEDDED_OPENSSL_O2=y
```

## br2-external/configs/tor_qemu_x86_64_defconfig
```kconfig
BR2_x86_64=y
BR2_TOOLCHAIN_BUILDROOT_MUSL=y
BR2_GCC_VERSION_15_X=y
BR2_BINUTILS_VERSION_2_45_X=y
BR2_KERNEL_HEADERS_AS_KERNEL=y
BR2_PACKAGE_HOST_LINUX_HEADERS_CUSTOM_6_18=y
BR2_REPRODUCIBLE=y
BR2_DOWNLOAD_FORCE_CHECK_HASHES=y
BR2_GLOBAL_PATCH_DIR="$(BR2_EXTERNAL_EMBEDDED_TOR_PATH)/patches"
BR2_OPTIMIZE_2=y
BR2_SSP_STRONG=y
BR2_PIC_PIE=y
BR2_RELRO_FULL=y
BR2_TARGET_GENERIC_HOSTNAME="embedded-tor-lab"
BR2_TARGET_GENERIC_ISSUE="Tor validation laboratory; no hardware verification"
# BR2_TARGET_ENABLE_ROOT_LOGIN is not set
# BR2_TARGET_GENERIC_GETTY is not set
BR2_SYSTEM_DHCP="eth0"
BR2_ROOTFS_OVERLAY="$(BR2_EXTERNAL_EMBEDDED_TOR_PATH)/board/qemu/overlay"
BR2_ROOTFS_POST_BUILD_SCRIPT="$(BR2_EXTERNAL_EMBEDDED_TOR_PATH)/board/qemu/post-build.sh"
BR2_PACKAGE_BUSYBOX_CONFIG="$(BR2_EXTERNAL_EMBEDDED_TOR_PATH)/board/qemu/busybox.config"
BR2_LINUX_KERNEL=y
BR2_LINUX_KERNEL_CUSTOM_VERSION=y
BR2_LINUX_KERNEL_CUSTOM_VERSION_VALUE="6.18.7"
BR2_LINUX_KERNEL_USE_CUSTOM_CONFIG=y
BR2_LINUX_KERNEL_CUSTOM_CONFIG_FILE="$(BR2_EXTERNAL_EMBEDDED_TOR_PATH)/board/qemu/linux.config"
BR2_LINUX_KERNEL_NEEDS_HOST_LIBELF=y
BR2_PACKAGE_TOR=y
BR2_PACKAGE_LIBSECCOMP=y
BR2_PACKAGE_PYTHON3=y
BR2_PACKAGE_PYTHON3_SSL=y
BR2_TARGET_ROOTFS_EXT2=y
BR2_TARGET_ROOTFS_EXT2_4=y
BR2_TARGET_ROOTFS_EXT2_SIZE="256M"
# BR2_TARGET_ROOTFS_TAR is not set
```

## br2-external/configs/tor_qemu_x86_64_small_defconfig
```kconfig
BR2_x86_64=y
BR2_TOOLCHAIN_EXTERNAL=y
BR2_TOOLCHAIN_EXTERNAL_CUSTOM=y
BR2_TOOLCHAIN_EXTERNAL_PREINSTALLED=y
BR2_TOOLCHAIN_EXTERNAL_PATH="$(BR2_EXTERNAL_EMBEDDED_TOR_PATH)/../build/toolchains/baseline-sdk"
BR2_TOOLCHAIN_EXTERNAL_CUSTOM_PREFIX="x86_64-buildroot-linux-musl"
BR2_TOOLCHAIN_EXTERNAL_GCC_15=y
BR2_TOOLCHAIN_EXTERNAL_HEADERS_6_18=y
BR2_TOOLCHAIN_EXTERNAL_CUSTOM_MUSL=y
BR2_TOOLCHAIN_EXTERNAL_HAS_SSP=y
BR2_TOOLCHAIN_EXTERNAL_HAS_SSP_STRONG=y
BR2_REPRODUCIBLE=y
BR2_DOWNLOAD_FORCE_CHECK_HASHES=y
BR2_GLOBAL_PATCH_DIR="$(BR2_EXTERNAL_EMBEDDED_TOR_PATH)/patches"
BR2_OPTIMIZE_2=y
BR2_SSP_STRONG=y
BR2_PIC_PIE=y
BR2_RELRO_FULL=y
BR2_TARGET_GENERIC_HOSTNAME="embedded-tor-lab"
BR2_TARGET_GENERIC_ISSUE="Tor validation laboratory; no hardware verification"
# BR2_TARGET_ENABLE_ROOT_LOGIN is not set
# BR2_TARGET_GENERIC_GETTY is not set
BR2_SYSTEM_DHCP="eth0"
BR2_ROOTFS_OVERLAY="$(BR2_EXTERNAL_EMBEDDED_TOR_PATH)/board/qemu/overlay"
BR2_ROOTFS_POST_BUILD_SCRIPT="$(BR2_EXTERNAL_EMBEDDED_TOR_PATH)/board/qemu-small/post-build.sh"
BR2_PACKAGE_BUSYBOX_CONFIG="$(BR2_EXTERNAL_EMBEDDED_TOR_PATH)/board/qemu/busybox.config"
BR2_LINUX_KERNEL=y
BR2_LINUX_KERNEL_CUSTOM_VERSION=y
BR2_LINUX_KERNEL_CUSTOM_VERSION_VALUE="6.18.7"
BR2_LINUX_KERNEL_USE_CUSTOM_CONFIG=y
BR2_LINUX_KERNEL_CUSTOM_CONFIG_FILE="$(BR2_EXTERNAL_EMBEDDED_TOR_PATH)/board/qemu/linux.config"
BR2_LINUX_KERNEL_NEEDS_HOST_LIBELF=y
BR2_PACKAGE_TOR=y
BR2_PACKAGE_LIBSECCOMP=y
BR2_PACKAGE_PYTHON3=y
BR2_PACKAGE_PYTHON3_SSL=y
BR2_TARGET_ROOTFS_EXT2=y
BR2_TARGET_ROOTFS_EXT2_4=y
BR2_TARGET_ROOTFS_EXT2_SIZE="64M"
# BR2_TARGET_ROOTFS_TAR is not set
```
